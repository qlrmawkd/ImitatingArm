
	.DEF _gBtnCnt=R4
	.DEF _gMSEC=R6
	.DEF _gSEC=R8
	.DEF _gMIN=R9
	.DEF _gHOUR=R10
	.DEF _gTx0Cnt=R11
	.DEF _gRx0Cnt=R12
	.DEF _gTx0BufIdx=R13
	.DEF _gOldRx1Byte=R14
_wCK_IDs:
	.DB  0x0,0x1,0x2,0x3,0x4,0x5,0x6,0x7
	.DB  0x8,0x9,0xA,0xB,0xC,0xD,0xE,0xF
_MotionZeroPos:
	.DB  0x7D,0xCA,0xA2,0x42,0x6C,0x7D,0x33,0x56
	.DB  0xB7,0x8E,0x59,0x2A,0x7C,0xA1,0xD0,0x7F
_M_EX1_RuntimePGain:
	.DB  0x14,0x14,0x14,0x14,0x14,0x14,0x14,0x14
	.DB  0x14,0x14,0x14,0x14,0x14,0x14,0x14,0x14
_M_EX1_RuntimeDGain:
	.DB  0x1E,0x1E,0x1E,0x1E,0x1E,0x1E,0x1E,0x1E
	.DB  0x1E,0x1E,0x1E,0x1E,0x1E,0x1E,0x1E,0x1E
_M_EX1_RuntimeIGain:
	.DB  0x0,0x0,0x0,0x0,0x0,0x0,0x0,0x0
	.DB  0x0,0x0,0x0,0x0,0x0,0x0,0x0,0x0
_M_EX1_Frames:
	.DB  0x1,0x0,0x1E,0x0,0xA,0x0,0x3,0x0
	.DB  0xA,0x0,0xA,0x0,0x1,0x0,0x1,0x0
	.DB  0xA,0x0,0x1E,0x0
_M_EX1_TrTime:
	.DB  0xF4,0x1,0xE8,0x3,0x2C,0x1,0x64,0x0
	.DB  0x2C,0x1,0x2C,0x1,0x32,0x0,0x58,0x2
	.DB  0x2C,0x1,0xE8,0x3
_M_EX1_Position:
	.DB  0x7D,0xB3,0xC7,0x58,0x6C,0x7E,0x48,0x31
	.DB  0xA3,0x8D,0x33,0x2F,0x31,0xC7,0xCD,0xCD
	.DB  0x7D,0xB3,0xC7,0x58,0x6C,0x7E,0x48,0x31
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	.DB  0x8B,0x8D,0x33,0x2F,0x31,0xC7,0xCE,0xCD
_M_EX1_Torque:
	.DB  0x2,0x2,0x2,0x2,0x2,0x2,0x2,0x2
	.DB  0x2,0x2,0x2,0x2,0x2,0x2,0x2,0x2
	.DB  0x2,0x2,0x2,0x2,0x2,0x2,0x2,0x2
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	.DB  0x2,0x2,0x2,0x2,0x2,0x2,0x2,0x2
_M_EX1_Port:
	.DB  0x0,0x0,0x0,0x0,0x0,0x0,0x0,0x0
	.DB  0x0,0x0,0x0,0x0,0x0,0x0,0x0,0x0
	.DB  0x0,0x0,0x0,0x0,0x0,0x0,0x0,0x0
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	.DB  0x0,0x0,0x0,0x0,0x0,0x0,0x0,0x0

__GLOBAL_INI_TBL:
	.DW  0
_0x77:
